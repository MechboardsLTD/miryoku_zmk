// Copyright 2021 Manna Harbour
// https://github.com/manna-harbour/miryoku

#include "../miryoku/custom_config.h"
#include "../miryoku/mapping/42/corne.h"
#include "../miryoku/miryoku.dtsi"

&nice_view_spi {
        cs-gpios = <&pro_micro 8 GPIO_ACTIVE_HIGH>;
};
